// Пример GyverOLED. Смотри документацию на http://alexgyver.ru/gyveroled/
// вывод картинки из памяти, буфер не используем

// битмап из программы BITmaper OLED (ищи в папке с библиотекой)
const uint8_t bitmap_26x26_min[] PROGMEM = {
  0x00, 0x00, 0x00, 0x00, 0x00, 0x00, 0x00, 0x00, 0x00, 0x00, 0x00, 0x00, 0x00, 0x00, 0x00, 0x00, 0x00, 0x00, 0x00, 0x00, 0x00, 0x00, 0x00, 0x00, 0x00, 0x00, 
  0x00, 0x00, 0x78, 0xFC, 0xFE, 0xFE, 0xFE, 0xFE, 0xFE, 0xFE, 0xFE, 0xFE, 0xFE, 0xFE, 0xFE, 0xFE, 0xFE, 0xFE, 0xFE, 0xFE, 0xFE, 0xFE, 0xFC, 0x78, 0x00, 0x00, 
  0x00, 0x00, 0x00, 0x00, 0x01, 0x01, 0x01, 0x01, 0x01, 0x01, 0x01, 0x01, 0x01, 0x01, 0x01, 0x01, 0x01, 0x01, 0x01, 0x01, 0x01, 0x01, 0x00, 0x00, 0x00, 0x00, 
  0x00, 0x00, 0x00, 0x00, 0x00, 0x00, 0x00, 0x00, 0x00, 0x00, 0x00, 0x00, 0x00, 0x00, 0x00, 0x00, 0x00, 0x00, 0x00, 0x00, 0x00, 0x00, 0x00, 0x00, 0x00, 0x00, 
};
const uint8_t bitmap_26x26_plus[] PROGMEM = {
  0x00, 0x00, 0x00, 0x00, 0x00, 0x00, 0x00, 0x00, 0x00, 0xFC, 0xFC, 0xFC, 0xFC, 0xFC, 0xFC, 0xFC, 0xFC, 0x00, 0x00, 0x00, 0x00, 0x00, 0x00, 0x00, 0x00, 0x00, 
  0x00, 0x00, 0xFE, 0xFE, 0xFE, 0xFE, 0xFE, 0xFE, 0xFE, 0xFF, 0xFF, 0xFF, 0xFF, 0xFF, 0xFF, 0xFF, 0xFF, 0xFE, 0xFE, 0xFE, 0xFE, 0xFE, 0xFE, 0xFE, 0x00, 0x00, 
  0x00, 0x00, 0x01, 0x01, 0x01, 0x01, 0x01, 0x01, 0x01, 0xFF, 0xFF, 0xFF, 0xFF, 0xFF, 0xFF, 0xFF, 0xFF, 0x01, 0x01, 0x01, 0x01, 0x01, 0x01, 0x01, 0x00, 0x00, 
  0x00, 0x00, 0x00, 0x00, 0x00, 0x00, 0x00, 0x00, 0x00, 0x00, 0x00, 0x00, 0x00, 0x00, 0x00, 0x00, 0x00, 0x00, 0x00, 0x00, 0x00, 0x00, 0x00, 0x00, 0x00, 0x00, 
};
#include <EncButton2.h>
EncButton2<EB_BTN> btn[4];
EncButton2<EB_BTN> back(INPUT_PULLUP, 2);
EncButton2<EB_BTN> ok(INPUT_PULLUP, 3);
EncButton2<EB_BTN> down(INPUT_PULLUP, 4);
EncButton2<EB_BTN> up(INPUT_PULLUP, 5);
#include <GyverOLED.h>          // Библиотека дисплея
GyverOLED<SSD1306_128x64, OLED_BUFFER> oled;
// можно передать адрес: GyverOLED oled(0x3C);
#include <EEPROM.h>
  byte proc;
  bool calib;
  bool actio;
void setup() { 
  Serial.begin(9600);
EEPROM.get(0, proc);
  oled.init();
  oled.clear();
  oled.setContrast(255); // Макс. яркость
  // вывод битмапа: (x, y, имя, размерХ, размерУ, инверсия INVERT или не указана)
  oled.home();            // курсор в 0,0
  oled.print(F(
  "        Колба 50 мл\n\r"
  "\n\r"
  "\n\r"
  "        Заполнение\n\r"
  "\n\r"
  "            "
  ));
  oled.print(proc);
  oled.print("%");
  oled.drawBitmap(4, 34, bitmap_26x26_min, 26, 26);
  oled.drawBitmap(4, 4, bitmap_26x26_plus, 26, 26);
  oled.update();
 
}

void loop() {
  up.tick();                 // Опрос кнопок
  down.tick();
  ok.tick();
  back.tick();
  bool actio = 0;
if(up.press()){oled.roundRect(2, 2, 32, 32, OLED_CLEAR);  oled.drawBitmap(4, 4, bitmap_26x26_plus, 26, 26); oled.roundRect(2, 32, 32, 62, OLED_STROKE); oled.update();calib = 1;}
if(down.press()){oled.roundRect(2, 32, 32, 62, OLED_CLEAR); oled.drawBitmap(4, 34, bitmap_26x26_min, 26, 26); oled.roundRect(2, 2, 32, 32,OLED_STROKE); oled.update();calib = 0;}
if(ok.press()&&proc>=20&&proc<=100){actio = 1;if(calib == 0&&proc<100){proc=proc+5;}if(calib == 1&&proc>20){proc=proc-5;}} 
 if(actio == 1){oled.setCursorXY(71, 40); // курсор в (пиксель X, пиксель Y)
  oled.print("    ");
 oled.setCursorXY(71, 40); // курсор в (пиксель X, пиксель Y)
  oled.print(proc);
  oled.print("%");
  }
}
